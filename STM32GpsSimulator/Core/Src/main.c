/* USER CODE BEGIN Header */
/**
  ******************************************************************************
  * @file           : main.c
  * @brief          : Main program body
  ******************************************************************************
  * @attention
  *
  * Copyright (c) 2026 STMicroelectronics.
  * All rights reserved.
  *
  * This software is licensed under terms that can be found in the LICENSE file
  * in the root directory of this software component.
  * If no LICENSE file comes with this software, it is provided AS-IS.
  *
  ******************************************************************************
  */
/* USER CODE END Header */
/* Includes ------------------------------------------------------------------*/
#include "main.h"

/* Private includes ----------------------------------------------------------*/
/* USER CODE BEGIN Includes */
#include <stdio.h>
/* USER CODE END Includes */

/* Private typedef -----------------------------------------------------------*/
/* USER CODE BEGIN PTD */

/* USER CODE END PTD */

/* Private define ------------------------------------------------------------*/
/* USER CODE BEGIN PD */
#define UART_DEBUG &huart3
/* USER CODE END PD */

/* Private macro -------------------------------------------------------------*/
/* USER CODE BEGIN PM */

/* USER CODE END PM */

/* Private variables ---------------------------------------------------------*/

I2C_HandleTypeDef hi2c1;

TIM_HandleTypeDef htim10;

UART_HandleTypeDef huart3;

/* USER CODE BEGIN PV */

/**
 * @brief GPS coordinate.
 */
typedef struct
{
    /**
     * @brief Latitude.
     */
    float latitude;

    /**
     * @brief Longitude.
     */
    float longitude;

} gps_coordinate_t;

/**
 * @brief Predefined GPS coordinates transmitted to the BeagleBone Green.
 *
 * The coordinates are grouped by city. Every timer tick switches
 * to the next entry in the table. When the BBG requests data over
 * I2C, the currently selected coordinates are transmitted.
 */
static const gps_coordinate_t gps_coordinates[] =
{
    /* Tel Aviv */
    { 10.100f, 10.150f },
    { 10.300f, 10.450f },
    { 10.550f, 10.600f },
    { 11.200f, 11.350f },
    { 12.750f, 12.900f },
    { 13.400f, 13.500f },

    /* Haifa */
    { 20.100f, 20.200f },
    { 21.300f, 21.450f },
    { 22.700f, 22.900f },
    { 24.200f, 24.350f },
    { 26.800f, 26.950f },
    { 28.500f, 28.700f },

    /* Jerusalem */
    { 30.100f, 30.200f },
    { 31.400f, 31.550f },
    { 32.800f, 32.950f },
    { 34.300f, 34.500f },
    { 36.700f, 36.850f },
    { 39.100f, 39.300f }
};

/**
 * @brief Number of predefined GPS coordinates.
 */
#define GPS_COORDINATES_COUNT (sizeof(gps_coordinates) / sizeof(gps_coordinates[0]))

/**
 * @brief Index of the current GPS coordinate.
 */
static volatile uint32_t current_coordinate = 0;

/**
 * @brief I2C transmission buffer.
 */
static gps_coordinate_t i2c_tx_packet;

/* USER CODE END PV */

/* Private function prototypes -----------------------------------------------*/
void SystemClock_Config(void);
static void MX_GPIO_Init(void);
static void MX_I2C1_Init(void);
static void MX_TIM10_Init(void);
static void MX_USART3_UART_Init(void);
/* USER CODE BEGIN PFP */

/* USER CODE END PFP */

/* Private user code ---------------------------------------------------------*/
/* USER CODE BEGIN 0 */

/**
 * @brief Redirect printf output to the debug UART.
 *
 * This function is used by the C standard library to transmit
 * characters generated by printf() over the debug UART interface.
 *
 * @param file File descriptor (unused).
 * @param ptr Pointer to the data buffer.
 * @param len Number of bytes to transmit.
 *
 * @return Number of transmitted bytes.
 */
int _write(int file, char *ptr, int len)
{
	HAL_UART_Transmit(UART_DEBUG, (uint8_t *)ptr, len, 0xFFFF);
	return len;
}

/**
 * @brief I2C error callback.
 *
 * Invoked by the HAL when an I2C communication error occurs.
 *
 * @param hi2c Pointer to the I2C handle that reported the error.
 */
void HAL_I2C_ErrorCallback(I2C_HandleTypeDef *hi2c)
{
    if (hi2c->Instance == I2C1)
    {
        printf("I2C error callback: 0x%08lX\r\n",
               (unsigned long)HAL_I2C_GetError(hi2c));
    }
}

/**
 * @brief Timer period elapsed callback.
 *
 * Invoked by the HAL when the TIM10 update event occurs.
 * Advances to the next predefined GPS coordinate, which
 * will be transmitted to the BeagleBone Green upon the
 * next I2C read request.
 *
 * @param htim Pointer to the timer handle.
 */
void HAL_TIM_PeriodElapsedCallback(TIM_HandleTypeDef *htim)
{
	uint32_t next_coordinate;

	if (htim->Instance == TIM10)
	{
		next_coordinate = current_coordinate + 1U;

		if (next_coordinate >= GPS_COORDINATES_COUNT)
		{
			next_coordinate = 0U;
		}

		current_coordinate = next_coordinate;

		/*
		 * Debug output used to verify that the timer switches
		 * between predefined GPS coordinates correctly.
		 *
		 * Uncomment if GPS coordinate sequencing needs to be verified.
		 */
		// printf("Latitude: %.6f, Longitude: %.6f\r\n",
		//        gps_coordinates[next_coordinate].latitude,
		//        gps_coordinates[next_coordinate].longitude);
	}
}

/**
 * @brief I2C address match callback.
 *
 * Invoked by the HAL when an I2C master addresses the STM32.
 * If the master requests data, the callback copies the currently
 * selected GPS coordinate into the transmission buffer and starts
 * the interrupt-driven I2C transfer.
 *
 * @param hi2c Pointer to the I2C handle.
 * @param transfer_direction Transfer direction from the master's
 *                           point of view.
 * @param address_match_code Address that matched the STM32 slave.
 */
void HAL_I2C_AddrCallback(I2C_HandleTypeDef *hi2c,
                          uint8_t transfer_direction,
                          uint16_t address_match_code)
{
	uint32_t coordinate_index;

	(void)address_match_code;

	/*
	 * Debug output used to verify I2C address match events
	 * and transfer direction during STM32-BBG integration.
	 *
	 * Uncomment for I2C communication troubleshooting.
	 */
	// printf("ADDR: direction=%u, address=%u\r\n",
	//        transfer_direction,
	//        address_match_code);

	if ((hi2c->Instance == I2C1) &&
		(transfer_direction == I2C_DIRECTION_RECEIVE))
	{
		coordinate_index = current_coordinate;
		i2c_tx_packet = gps_coordinates[coordinate_index];

		HAL_I2C_Slave_Seq_Transmit_IT(
			hi2c,
			(uint8_t *)&i2c_tx_packet,
			sizeof(i2c_tx_packet),
			I2C_LAST_FRAME);
	}
}

/**
 * @brief I2C listen complete callback.
 *
 * Invoked by the HAL when the current I2C listen sequence is
 * completed. Re-enables listen mode so that the STM32 can process
 * the next request from the BeagleBone Green.
 *
 * @param hi2c Pointer to the I2C handle.
 */
void HAL_I2C_ListenCpltCallback(I2C_HandleTypeDef *hi2c)
{
    if (hi2c->Instance == I2C1)
    {
    	if (HAL_I2C_EnableListen_IT(hi2c) != HAL_OK)
		{
			Error_Handler();
		}
    }
}


/* USER CODE END 0 */

/**
  * @brief  The application entry point.
  * @retval int
  */
int main(void)
{

  /* USER CODE BEGIN 1 */

  /* USER CODE END 1 */

  /* MCU Configuration--------------------------------------------------------*/

  /* Reset of all peripherals, Initializes the Flash interface and the Systick. */
  HAL_Init();

  /* USER CODE BEGIN Init */

  /* USER CODE END Init */

  /* Configure the system clock */
  SystemClock_Config();

  /* USER CODE BEGIN SysInit */

  /* USER CODE END SysInit */

  /* Initialize all configured peripherals */
  MX_GPIO_Init();
  MX_I2C1_Init();
  MX_TIM10_Init();
  MX_USART3_UART_Init();
  /* USER CODE BEGIN 2 */

  if (HAL_TIM_Base_Start_IT(&htim10) != HAL_OK)
  {
      Error_Handler();
  }

  if (HAL_I2C_EnableListen_IT(&hi2c1) != HAL_OK)
  {
      Error_Handler();
  }

  /* USER CODE END 2 */

  /* Infinite loop */
  /* USER CODE BEGIN WHILE */
  while (1)
  {
    /* USER CODE END WHILE */

    /* USER CODE BEGIN 3 */
  }
  /* USER CODE END 3 */
}

/**
  * @brief System Clock Configuration
  * @retval None
  */
void SystemClock_Config(void)
{
  RCC_OscInitTypeDef RCC_OscInitStruct = {0};
  RCC_ClkInitTypeDef RCC_ClkInitStruct = {0};

  /** Configure the main internal regulator output voltage
  */
  __HAL_RCC_PWR_CLK_ENABLE();
  __HAL_PWR_VOLTAGESCALING_CONFIG(PWR_REGULATOR_VOLTAGE_SCALE3);

  /** Initializes the RCC Oscillators according to the specified parameters
  * in the RCC_OscInitTypeDef structure.
  */
  RCC_OscInitStruct.OscillatorType = RCC_OSCILLATORTYPE_HSI;
  RCC_OscInitStruct.HSIState = RCC_HSI_ON;
  RCC_OscInitStruct.HSICalibrationValue = RCC_HSICALIBRATION_DEFAULT;
  RCC_OscInitStruct.PLL.PLLState = RCC_PLL_NONE;
  if (HAL_RCC_OscConfig(&RCC_OscInitStruct) != HAL_OK)
  {
    Error_Handler();
  }

  /** Initializes the CPU, AHB and APB buses clocks
  */
  RCC_ClkInitStruct.ClockType = RCC_CLOCKTYPE_HCLK|RCC_CLOCKTYPE_SYSCLK
                              |RCC_CLOCKTYPE_PCLK1|RCC_CLOCKTYPE_PCLK2;
  RCC_ClkInitStruct.SYSCLKSource = RCC_SYSCLKSOURCE_HSI;
  RCC_ClkInitStruct.AHBCLKDivider = RCC_SYSCLK_DIV1;
  RCC_ClkInitStruct.APB1CLKDivider = RCC_HCLK_DIV1;
  RCC_ClkInitStruct.APB2CLKDivider = RCC_HCLK_DIV1;

  if (HAL_RCC_ClockConfig(&RCC_ClkInitStruct, FLASH_LATENCY_0) != HAL_OK)
  {
    Error_Handler();
  }
}

/**
  * @brief I2C1 Initialization Function
  * @param None
  * @retval None
  */
static void MX_I2C1_Init(void)
{

  /* USER CODE BEGIN I2C1_Init 0 */

  /* USER CODE END I2C1_Init 0 */

  /* USER CODE BEGIN I2C1_Init 1 */

  /* USER CODE END I2C1_Init 1 */
  hi2c1.Instance = I2C1;
  hi2c1.Init.Timing = 0x0010061A;
  hi2c1.Init.OwnAddress1 = 132;
  hi2c1.Init.AddressingMode = I2C_ADDRESSINGMODE_7BIT;
  hi2c1.Init.DualAddressMode = I2C_DUALADDRESS_DISABLE;
  hi2c1.Init.OwnAddress2 = 0;
  hi2c1.Init.OwnAddress2Masks = I2C_OA2_NOMASK;
  hi2c1.Init.GeneralCallMode = I2C_GENERALCALL_DISABLE;
  hi2c1.Init.NoStretchMode = I2C_NOSTRETCH_DISABLE;
  if (HAL_I2C_Init(&hi2c1) != HAL_OK)
  {
    Error_Handler();
  }

  /** Configure Analogue filter
  */
  if (HAL_I2CEx_ConfigAnalogFilter(&hi2c1, I2C_ANALOGFILTER_ENABLE) != HAL_OK)
  {
    Error_Handler();
  }

  /** Configure Digital filter
  */
  if (HAL_I2CEx_ConfigDigitalFilter(&hi2c1, 0) != HAL_OK)
  {
    Error_Handler();
  }
  /* USER CODE BEGIN I2C1_Init 2 */

  /* USER CODE END I2C1_Init 2 */

}

/**
  * @brief TIM10 Initialization Function
  * @param None
  * @retval None
  */
static void MX_TIM10_Init(void)
{

  /* USER CODE BEGIN TIM10_Init 0 */

  /* USER CODE END TIM10_Init 0 */

  /* USER CODE BEGIN TIM10_Init 1 */

  /* USER CODE END TIM10_Init 1 */
  htim10.Instance = TIM10;
  htim10.Init.Prescaler = 15999;
  htim10.Init.CounterMode = TIM_COUNTERMODE_UP;
  htim10.Init.Period = 999;
  htim10.Init.ClockDivision = TIM_CLOCKDIVISION_DIV1;
  htim10.Init.AutoReloadPreload = TIM_AUTORELOAD_PRELOAD_DISABLE;
  if (HAL_TIM_Base_Init(&htim10) != HAL_OK)
  {
    Error_Handler();
  }
  /* USER CODE BEGIN TIM10_Init 2 */

  /* USER CODE END TIM10_Init 2 */

}

/**
  * @brief USART3 Initialization Function
  * @param None
  * @retval None
  */
static void MX_USART3_UART_Init(void)
{

  /* USER CODE BEGIN USART3_Init 0 */

  /* USER CODE END USART3_Init 0 */

  /* USER CODE BEGIN USART3_Init 1 */

  /* USER CODE END USART3_Init 1 */
  huart3.Instance = USART3;
  huart3.Init.BaudRate = 115200;
  huart3.Init.WordLength = UART_WORDLENGTH_8B;
  huart3.Init.StopBits = UART_STOPBITS_1;
  huart3.Init.Parity = UART_PARITY_NONE;
  huart3.Init.Mode = UART_MODE_TX_RX;
  huart3.Init.HwFlowCtl = UART_HWCONTROL_NONE;
  huart3.Init.OverSampling = UART_OVERSAMPLING_16;
  huart3.Init.OneBitSampling = UART_ONE_BIT_SAMPLE_DISABLE;
  huart3.AdvancedInit.AdvFeatureInit = UART_ADVFEATURE_NO_INIT;
  if (HAL_UART_Init(&huart3) != HAL_OK)
  {
    Error_Handler();
  }
  /* USER CODE BEGIN USART3_Init 2 */

  /* USER CODE END USART3_Init 2 */

}

/**
  * @brief GPIO Initialization Function
  * @param None
  * @retval None
  */
static void MX_GPIO_Init(void)
{
  /* USER CODE BEGIN MX_GPIO_Init_1 */

  /* USER CODE END MX_GPIO_Init_1 */

  /* GPIO Ports Clock Enable */
  __HAL_RCC_GPIOD_CLK_ENABLE();
  __HAL_RCC_GPIOB_CLK_ENABLE();

  /* USER CODE BEGIN MX_GPIO_Init_2 */

  /* USER CODE END MX_GPIO_Init_2 */
}

/* USER CODE BEGIN 4 */

/* USER CODE END 4 */

/**
  * @brief  This function is executed in case of error occurrence.
  * @retval None
  */
void Error_Handler(void)
{
  /* USER CODE BEGIN Error_Handler_Debug */
  /* User can add his own implementation to report the HAL error return state */
  __disable_irq();
  while (1)
  {
  }
  /* USER CODE END Error_Handler_Debug */
}
#ifdef USE_FULL_ASSERT
/**
  * @brief  Reports the name of the source file and the source line number
  *         where the assert_param error has occurred.
  * @param  file: pointer to the source file name
  * @param  line: assert_param error line source number
  * @retval None
  */
void assert_failed(uint8_t *file, uint32_t line)
{
  /* USER CODE BEGIN 6 */
  /* User can add his own implementation to report the file name and line number,
     ex: printf("Wrong parameters value: file %s on line %d\r\n", file, line) */
  /* USER CODE END 6 */
}
#endif /* USE_FULL_ASSERT */
